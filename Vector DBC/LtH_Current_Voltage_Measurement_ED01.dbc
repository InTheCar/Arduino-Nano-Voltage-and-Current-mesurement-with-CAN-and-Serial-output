VERSION ""

NS_ :

BS_:

BU_: LtHCuVo

BO_ 3221225472 VECTOR__INDEPENDENT_SIG_MSG: 0 Vector__XXX
 SG_ _06LSB_Voltage_average_10_mV : 0|8@0+ (1,0) [0|255] "" Vector__XXX
 SG_ _05MSB_Voltage_average_10_mV : 0|8@0+ (1,0) [0|255] "" Vector__XXX
 SG_ _04Voltage_average_10_mV : 0|16@0+ (1,0) [0|30000] "" Vector__XXX
 SG_ LSB_Current_mA : 0|8@0+ (1,0) [0|255] "" Vector__XXX
 SG_ _03LSB_Votage_mV : 0|8@0+ (1,0) [0|255] "" Vector__XXX
 SG_ _02MSB_Voltage_mV : 0|8@0+ (1,0) [0|255] "" Vector__XXX
 SG_ MSB_Current_mA : 0|8@0+ (1,0) [0|255] "" Vector__XXX
 SG_ Current_mA : 0|16@0+ (1,0) [0|30000] "" Vector__XXX
 SG_ _01Voltage_mV : 0|16@0+ (1,0) [0|30000] "" Vector__XXX

BO_ 1 LtH_Cur_Vol: 12 Vector__XXX

CM_ BO_ 3221225472 "This is a message for not used signals, created by Vector CANdb++ DBC OLE DB Provider.";
BA_DEF_ BO_  "CANFD_BRS" ENUM  "0","1";
BA_DEF_  "DBName" STRING ;
BA_DEF_  "BusType" STRING ;
BA_DEF_ BO_  "VFrameFormat" ENUM  "StandardCAN","ExtendedCAN","reserved","reserved","reserved","reserved","reserved","reserved","reserved","reserved","reserved","reserved","reserved","reserved","StandardCAN_FD","ExtendedCAN_FD";
BA_DEF_DEF_  "CANFD_BRS" "1";
BA_DEF_DEF_  "DBName" "";
BA_DEF_DEF_  "BusType" "";
BA_DEF_DEF_  "VFrameFormat" "StandardCAN";
BA_ "BusType" "CAN FD";
BA_ "DBName" "LtH_Current_Voltage_Measurement_";
BA_ "VFrameFormat" BO_ 1 14;
