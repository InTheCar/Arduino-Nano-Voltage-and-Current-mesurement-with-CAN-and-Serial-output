VERSION ""

NS_ :

BS_:

BU_: LtHCuVo

BO_ 1 LtH_Cur_Vol: 4 Vector__XXX
 SG_ Current_mA : 23|16@0+ (1,0) [0|30000] "" Vector__XXX
 SG_ Voltage_mV : 7|16@0+ (1,0) [0|30000] "" Vector__XXX

BA_DEF_ BO_  "CANFD_BRS" ENUM  "0","1";
BA_DEF_  "DBName" STRING ;
BA_DEF_  "BusType" STRING ;
BA_DEF_ BO_  "VFrameFormat" ENUM  "StandardCAN","ExtendedCAN","reserved","reserved","reserved","reserved","reserved","reserved","reserved","reserved","reserved","reserved","reserved","reserved","StandardCAN_FD","ExtendedCAN_FD";
BA_DEF_DEF_  "CANFD_BRS" "1";
BA_DEF_DEF_  "DBName" "";
BA_DEF_DEF_  "BusType" "";
BA_DEF_DEF_  "VFrameFormat" "StandardCAN";
BA_ "BusType" "CAN FD";
BA_ "DBName" "LtH_Current_Voltage_Measurement_";
BA_ "VFrameFormat" BO_ 1 14;
